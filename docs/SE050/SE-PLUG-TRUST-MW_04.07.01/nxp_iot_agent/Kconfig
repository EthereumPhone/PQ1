## docs/SE050/SE-PLUG-TRUST-MW_04.07.01/nxp_iot_agent/Kconfig
```kconfig
menu "NXP IoT Agent"
    config MCUX_COMPONENT_middleware.nxp_iot_agent.lwip_enet
        bool

    config MCUX_COMPONENT_middleware.nxp_iot_agent.lwip_wifi
        bool

    config MCUX_COMPONENT_middleware.nxp_iot_agent.sss
        bool
        select MCUX_COMPONENT_middleware.se_hostlib.commonSe050CloudDemos
        select MCUX_COMPONENT_middleware.se_hostlib.tstutils.time

    config MCUX_COMPONENT_middleware.nxp_iot_agent.psa
        bool

    config MCUX_COMPONENT_middleware.nxp_iot_agent
        bool "NXP IoT Agent library sources"
        depends on MCUX_HW_BOARD_evkbmimxrt1060 || MCUX_HW_BOARD_evkcmimxrt1060 || MCUX_HW_BOARD_evkbmimxrt1170 || MCUX_HW_BOARD_rdrw612bga || MCUX_HW_BOARD_frdmrw612
        select MCUX_COMPONENT_middleware.nxp_iot_agent.sss if MCUX_HW_BOARD_evkbmimxrt1060 || MCUX_HW_BOARD_evkcmimxrt1060 || MCUX_HW_BOARD_evkbmimxrt1170
        select MCUX_COMPONENT_middleware.nxp_iot_agent.psa if MCUX_HW_BOARD_rdrw612bga || MCUX_HW_BOARD_frdmrw612
    if MCUX_COMPONENT_middleware.nxp_iot_agent
        choice
            prompt "Network backend"
            config MCUX_DEPENDENCY_COMPONENT_middleware.nxp_iot_agent.network.lwip_enet
                bool "lwIP Ethernet"
                select MCUX_COMPONENT_middleware.nxp_iot_agent.lwip_enet
            config MCUX_DEPENDENCY_COMPONENT_middleware.nxp_iot_agent.network.lwip_wifi
                bool "lwIP Wi-Fi"
                select MCUX_COMPONENT_middleware.nxp_iot_agent.lwip_wifi
        endchoice
    endif

    config MCUX_COMPONENT_middleware.nxp_iot_agent.mqtt
        bool "Standalone MQTT library sources"
        depends on MCUX_HW_BOARD_rdrw612bga || MCUX_HW_BOARD_frdmrw612 || MCUX_HW_BOARD_mcxn5xxevk || MCUX_HW_BOARD_mcxn9xxevk || MCUX_HW_BOARD_frdmmcxn947
    if MCUX_COMPONENT_middleware.nxp_iot_agent.mqtt
        choice
            prompt "Network backend"
            config MCUX_DEPENDENCY_COMPONENT_middleware.nxp_iot_agent.mqtt.network.lwip_enet
                bool "lwIP Ethernet"
                select MCUX_COMPONENT_middleware.nxp_iot_agent.lwip_enet
            config MCUX_DEPENDENCY_COMPONENT_middleware.nxp_iot_agent.mqtt.network.lwip_wifi
                bool "lwIP Wi-Fi"
                select MCUX_COMPONENT_middleware.nxp_iot_agent.lwip_wifi
        endchoice
    endif

    config MCUX_COMPONENT_middleware.nxp_iot_agent.claimcode
        bool "Standalone Claimcode library sources"
        depends on MCUX_HW_BOARD_rdrw612bga || MCUX_HW_BOARD_frdmrw612
endmenu
```

## docs/SE050/SE-PLUG-TRUST-MW_04.07.01/nxp_iot_agent/zephyr/Kconfig
```kconfig
# Copyright 2024 NXP
# SPDX-License-Identifier: Apache-2.0

config EL2GO_COMMON
    bool "Include EL2GO common configuration"
    help
        Includes the common EL2GO headers and defines in the app.

config EL2GO_AGENT_LIBRARY_SOURCES
    bool "Build EL2GO Agent library sources"
    select EL2GO_COMMON
    depends on BUILD_WITH_TFM && NET_SOCKETS && MBEDTLS && HWINFO
    help
        Include the EdgeLock 2GO agent library sources in the app.

config EL2GO_MQTT_LIBRARY_SOURCES
    bool "Build EL2GO MQTT library sources"
    select EL2GO_COMMON
    depends on BUILD_WITH_TFM && NET_SOCKETS && MBEDTLS && !EL2GO_AGENT_LIBRARY_SOURCES
    help
        Include the EdgeLock 2GO MQTT library sources in the app.

config EL2GO_TFM_LEGACY_CRYPTO_ENABLE
    bool "Enable EL2GO TF-M legacy crypto"
    depends on BUILD_WITH_TFM
    help
        Enables usage of legacy crypto inside TF-M (e.g. SHA-1 hashes) by EL2GO.

config EL2GO_TFM_DATA_IMPORT_REGION
    bool "Configure EL2GO TF-M data import region"
    depends on BUILD_WITH_TFM
    help
        Configure the flash memory region of the EL2GO offline provisioned blobs to be accessible from EL2GO NSPE apps.

config EL2GO_SIGN_USING_NXPIMAGE
    bool "Sign s/ns binaries using nxpimage"
    help
        Sign s/ns binaries using SPSDK nxpimage tool.

config EL2GO_PRIVATE_KEY
    string "Private key input"
    depends on EL2GO_SIGN_USING_NXPIMAGE
    help
        Private key input to sign merged s/ns image.

config EL2GO_CERT_BLOCK
    string "Certificate file"
    depends on EL2GO_SIGN_USING_NXPIMAGE
    help
        Certificate input for the keys.
```

## docs/SE050/SE-PLUG-TRUST-MW_04.07.01/nxp_iot_agent/zephyr/samples/el2go_agent/Kconfig
```kconfig
# Copyright 2024 NXP
# SPDX-License-Identifier: Apache-2.0

source "Kconfig.zephyr"

config EDGELOCK2GO_HOSTNAME
    string "EL2GO Hostname"
    help
        The hostname for agent to connect to the EdgeLock 2GO cloud service.

config IOT_AGENT_CLAIMCODE_INJECT_ENABLE
    bool "Claimcode enable flag"
    help
        Flag for enabling provisioning through claimcode.

config IOT_AGENT_MQTT_ENABLE
    bool "Claimcode enable flag"
    help
        Flag for enabling provisioning through claimcode.

config AWS_SERVICE_KEY_PAIR_ID
    hex "AWS Key Pair ID"
    default 0x0
    help
        AWS key pair ID for el2go_agent.

config AWS_SERVICE_DEVICE_CERT_ID
    hex "AWS Certificate"
    default 0x0
    help
        AWS certificate ID.

config AZURE_SERVICE_KEY_PAIR_ID
    hex "AZURE Key Pair ID"
    default 0x0
    help
        AZURE key pair ID for el2go_agent.

config AZURE_SERVICE_DEVICE_CERT_ID
    hex "AZURE Certificate"
    default 0x0
    help
        AZURE certificate ID.

config AP_SSID
    string "SSID"
    help
        The SSID the agent connects to.

config AP_PASSWORD
    string "WIFI Password"
    help
        The password for wifi with given SSID.
```

## docs/SE050/SE-PLUG-TRUST-MW_04.07.01/nxp_iot_agent/zephyr/samples/el2go_agent/sample.yaml
```yaml
sample:
  name: EL2GO Agent
  description: The EdgeLock 2GO agent sample demonstrates how to connect to EdgeLock 2GO and provision secure objects to the chip
tests:
  sample.nxp_iot_agent.el2go_agent_whitelisting:
    tags:
      - el2go
      - trusted-firmware-m
      - net
      - wifi
      - cloud
      - mqtt
    platform_allow:
      - rd_rw612_bga/rw612/ns
      - frdm_rw612/rw612/ns
    timeout: 150
    harness: console
    harness_config:
      type: multi_line
      fixture: fixture_el2go
      regex:
        - "Successfully connected to WIFI"
        - "The device update was successful"
        - "On endpoint (0[xX]([0-9a-fA-F]){8}), for object (0[xX]([0-9a-fA-F]){8}), status: 0x0001: SUCCESS."
        - "On endpoint (0[xX]([0-9a-fA-F]){8}), for object (0[xX]([0-9a-fA-F]){8}), status: 0x0001: SUCCESS."
        - "On endpoint (0[xX]([0-9a-fA-F]){8}), for object (0[xX]([0-9a-fA-F]){8}), status: 0x0001: SUCCESS."
        - "On endpoint (0[xX]([0-9a-fA-F]){8}), for object (0[xX]([0-9a-fA-F]){8}), status: 0x0001: SUCCESS."
  sample.nxp_iot_agent.el2go_agent_claimcode_mqtt:
    extra_args:
      - OVERLAY_CONFIG="overlay-el2go-claimcode-mqtt-rw61x.conf"
    tags:
      - el2go
      - trusted-firmware-m
      - net
      - wifi
      - cloud
      - mqtt
    platform_allow:
      - rd_rw612_bga/rw612/ns
      - frdm_rw612/rw612/ns
    timeout: 200
    harness: console
    harness_config:
      type: multi_line
      fixture: fixture_el2go
      regex:
        - "Successfully connected to WIFI"
        - "Claimcode imported into psa its with object id (0[xX]([0-9a-fA-F]){8})"
        - "The device update was successful"
        - "On endpoint (0[xX]([0-9a-fA-F]){8}), for object (0[xX]([0-9a-fA-F]){8}), status: 0x0001: SUCCESS."
        - "On endpoint (0[xX]([0-9a-fA-F]){8}), for object (0[xX]([0-9a-fA-F]){8}), status: 0x0001: SUCCESS."
        - "On endpoint (0[xX]([0-9a-fA-F]){8}), for object (0[xX]([0-9a-fA-F]){8}), status: 0x0001: SUCCESS."
        - "On endpoint (0[xX]([0-9a-fA-F]){8}), for object (0[xX]([0-9a-fA-F]){8}), status: 0x0001: SUCCESS."
        - "Attempting to connect to service 'awstest(.+)'"
        - "Successfully published"
        - "Successfully published"
        - "Successfully published"
        - "Successfully published"
        - "Attempting to register service 'azuretest(.+)'"
        - "Successfully published"
        - "Successfully published"
        - "Successfully published"
        - "Successfully published"
  sample.nxp_iot_agent.el2go_agent_whitelisting_mqtt:
    extra_args:
      - OVERLAY_CONFIG="overlay-el2go-whitelisting-mqtt-rw61x.conf"
    tags:
      - el2go
      - trusted-firmware-m
      - net
      - wifi
      - cloud
      - mqtt
    platform_allow:
      - rd_rw612_bga/rw612/ns
      - frdm_rw612/rw612/ns
    timeout: 200
    harness: console
    harness_config:
      type: multi_line
      fixture: fixture_el2go
      regex:
        - "Successfully connected to WIFI"
        - "The device update was successful"
        - "On endpoint (0[xX]([0-9a-fA-F]){8}), for object (0[xX]([0-9a-fA-F]){8}), status: 0x0001: SUCCESS."
        - "On endpoint (0[xX]([0-9a-fA-F]){8}), for object (0[xX]([0-9a-fA-F]){8}), status: 0x0001: SUCCESS."
        - "On endpoint (0[xX]([0-9a-fA-F]){8}), for object (0[xX]([0-9a-fA-F]){8}), status: 0x0001: SUCCESS."
        - "On endpoint (0[xX]([0-9a-fA-F]){8}), for object (0[xX]([0-9a-fA-F]){8}), status: 0x0001: SUCCESS."
        - "Attempting to connect to service 'awstest(.+)'"
        - "Successfully published"
        - "Successfully published"
        - "Successfully published"
        - "Successfully published"
        - "Attempting to register service 'azuretest(.+)'"
        - "Successfully published"
        - "Successfully published"
        - "Successfully published"
        - "Successfully published"
```

## docs/SE050/SE-PLUG-TRUST-MW_04.07.01/nxp_iot_agent/zephyr/samples/el2go_claimcode_encryption/sample.yaml
```yaml
sample:
  name: EL2GO Claimcode Encryption
  description: The EdgeLock 2GO claimcode encryption sample demonstrates how to encrypt a claimcode for onboarding a device with the EdgeLock 2GO cloud service
tests:
  sample.nxp_iot_agent.el2go_claimcode_encryption.pytest:
    extra_args:
      - OVERLAY_CONFIG="overlay.conf"
    tags:
      - crypto
      - el2go
      - els_pkc
    platform_allow:
      - frdm_rw612
      - rd_rw612_bga
    harness: pytest
    timeout: 100
```

## docs/SE050/SE-PLUG-TRUST-MW_04.07.01/nxp_iot_agent/zephyr/samples/el2go_import_blob/Kconfig
```kconfig
# Copyright 2024 NXP
# SPDX-License-Identifier: Apache-2.0

source "Kconfig.zephyr"

config VALIDATE_PSA_IMPORT_OPERATION
    bool "Validate imported blob"
    help
        Validate imported blob fetched from flash.
```

## docs/SE050/SE-PLUG-TRUST-MW_04.07.01/nxp_iot_agent/zephyr/samples/el2go_import_blob/sample.yaml
```yaml
sample:
  name: EL2GO Import Blob
  description: The EdgeLock 2GO import blob sample demonstrates how to import and optionally use offline provisioned blobs from flash
tests:
  sample.nxp_iot_agent.el2go_import_blob:
    extra_args:
      - OVERLAY_CONFIG="overlay-el2go-rw61x.conf"
    tags:
      - el2go
      - trusted-firmware-m
    platform_allow:
      - rd_rw612_bga/rw612/ns
      - frdm_rw612/rw612/ns
    harness: console
    harness_config:
      fixture: fixture_el2go
      type: multi_line
      regex:
        - "2 blob\\(s\\) imported from flash successfully"
        - Cipher encrypt passed!
        - ECC sign passed!
```

## docs/SE050/SE-PLUG-TRUST-MW_04.07.01/nxp_iot_agent/zephyr/samples/el2go_mqtt_demo/Kconfig
```kconfig
# Copyright 2024 NXP
# SPDX-License-Identifier: Apache-2.0

source "Kconfig.zephyr"

config AWS_SERVICE_KEY_PAIR_ID
    hex "AWS Key Pair ID"
    default 0x0
    help
        AWS key pair ID for el2go_agent.

config AWS_SERVICE_DEVICE_CERT_ID
    hex "AWS Certificate"
    default 0x0
    help
        AWS certificate ID.

config AZURE_SERVICE_KEY_PAIR_ID
    hex "AZURE Key Pair ID"
    default 0x0
    help
        AZURE key pair ID for el2go_agent.

config AZURE_SERVICE_DEVICE_CERT_ID
    hex "AZURE Certificate"
    default 0x0
    help
        AZURE certificate ID.

config AP_SSID
    string "SSID"
    help
        The SSID the agent connects to.

config AP_PASSWORD
    string "WIFI Password"
    help
        The password for wifi with given SSID.
```

## docs/SE050/SE-PLUG-TRUST-MW_04.07.01/nxp_iot_agent/zephyr/samples/el2go_mqtt_demo/sample.yaml
```yaml
sample:
  name: EL2GO MQTT Demo
  description: The EdgeLock 2GO MQTT demo sample demonstrates a connection to AWS or Azure MQTT services with preprovisioned EL2GO objects
tests:
  sample.nxp_iot_agent.el2go_mqtt_demo:
    extra_args:
      - OVERLAY_CONFIG="overlay-el2go-rw61x.conf"
    tags:
      - el2go
      - trusted-firmware-m
      - net
      - wifi
      - cloud
      - mqtt
    platform_allow:
      - rd_rw612_bga/rw612/ns
      - frdm_rw612/rw612/ns
    harness: console
    harness_config:
      fixture: fixture_el2go
      type: multi_line
      regex:
        - "Successfully connected to WIFI"
        - "Attempting to connect to service 'awstest(.+)'"
        - "Successfully published"
        - "Successfully published"
        - "Successfully published"
        - "Successfully published"
        - "Attempting to register service 'azuretest(.+)'"
        - "Successfully published"
        - "Successfully published"
        - "Successfully published"
        - "Successfully published"
        - "EL2GO MQTT Client successfully finished"
```

## docs/SE050/SE-PLUG-TRUST-MW_04.07.01/nxp_iot_agent/zephyr/tests/el2go_blob_test/Kconfig
```kconfig
# Copyright 2024 NXP
# SPDX-License-Identifier: Apache-2.0

source "Kconfig.zephyr"

config RUN_VERIFIED_ONLY
    default y
    bool "Only run testcases that are expected to pass"

config LARGE_BLOBS_ENABLED
    bool "Enable testing of blobs with a key size larger than 2783 bytes"

config RTP_JSON
    string "Path to the RTP JSON file from EdgeLock 2GO"
```

## docs/SE050/SE-PLUG-TRUST-MW_04.07.01/nxp_iot_agent/zephyr/tests/el2go_blob_test/testcase.yaml
```yaml
tests:
  nxp_iot_agent.el2go_blob_test:
    tags:
      - crypto
      - el2go
      - trusted-firmware-m
    platform_allow:
      - rd_rw612_bga/rw612/ns
      - frdm_rw612/rw612/ns
    timeout: 1500
    harness: console
    harness_config:
      fixture: fixture_el2go
      type: multi_line
      regex:
        - "\\#\\#\\#\\# Start EL2GO blob tests \\#\\#\\#\\#"
        - "Test suite GENERIC \\((.+)\\) - PASSED"
        - "\\#\\#\\#\\# EL2GO blob tests finished \\#\\#\\#\\#"
```
